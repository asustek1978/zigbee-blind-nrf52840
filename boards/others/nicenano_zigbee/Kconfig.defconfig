## boards/others/nicenano_zigbee/Kconfig.defconfig
```kconfig
if BOARD_NICENANO_ZIGBEE

config HW_STACK_PROTECTION
    default ARCH_HAS_STACK_PROTECTION

endif
```

## boards/others/nicenano_zigbee/Kconfig.nicenano_zigbee
```kconfig
config BOARD_NICENANO_ZIGBEE
    select SOC_NRF52840_QIAA if BOARD_NICENANO_ZIGBEE_NRF52840
```

## boards/others/nicenano_zigbee/board.yml
```yaml
board:
  name: nicenano_zigbee
  full_name: nice!nano nRF52840 Zigbee prototype
  vendor: others
  socs:
    - name: nrf52840
```
