## CMakeLists.txt
```
cmake_minimum_required(VERSION 3.20.0)
find_package(Zephyr REQUIRED HINTS $ENV{ZEPHYR_BASE})
project(p3_sleep_probe)
target_sources(app PRIVATE src/main.c)
```

## prj.conf
```kconfig
CONFIG_GPIO=y
CONFIG_PM=y
CONFIG_PM_DEVICE=y
CONFIG_TICKLESS_KERNEL=y
CONFIG_LOG=n
CONFIG_CONSOLE=n
CONFIG_UART_CONSOLE=n
CONFIG_PRINTK=n
CONFIG_SERIAL=n
CONFIG_BOOT_BANNER=n
CONFIG_MAIN_STACK_SIZE=1024
```

## src/main.c
```c
/* v42.0-6: Zephyr idle-current test; SPARE BOARD ONLY.
 * No Zigbee, no motor control, no System OFF.
 * The kernel idle thread may enter System ON low-power sleep.
 * Measurement baseline: v41.3 draws 1.54 mA on the spare board with red LED removed.
 * Measure after 30-60 seconds on battery, with USB disconnected.
 */
#include <zephyr/kernel.h>
#include <zephyr/device.h>
#include <zephyr/drivers/gpio.h>
#include <zephyr/devicetree.h>

int main(void)
{
    const struct device *gpio0 = DEVICE_DT_GET(DT_NODELABEL(gpio0));
    if (device_is_ready(gpio0)) {
        (void)gpio_pin_configure(gpio0, 13, GPIO_OUTPUT_LOW);
        (void)gpio_pin_configure(gpio0, 15, GPIO_OUTPUT_HIGH);
    }
    /* No active polling, logging, or periodic timer after startup. */
    k_sleep(K_FOREVER);
    return 0;
}
```
